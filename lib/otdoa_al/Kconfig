## lib/otdoa_al/Kconfig
```kconfig
#
#  Copyright (c) 2025 PHY Wireless, Inc.
#
#  SPDX-License-Identifier: LicenseRef-PHYW
#

menuconfig OTDOA_AL_LIB
	bool "OTDOA library"
	help
		The OTDOA AL library enables the hellaPHY OTDOA positioning method

if OTDOA_AL_LIB

module = OTDOA_AL_LIB
module-str = OTDOA AL library

config OTDOA_DEFAULT_TIMEOUT_MS
	int "Default timeout to use for OTDOA operations, in milliseconds"
	default 120000

config OTDOA_SHELL_COMMANDS
	bool "PHYWI shell commands for testing OTDOA"
	default n

choice OTDOA_LIB_TYPE
	prompt "Build Type"
	default OTDOA_LIB_TYPE_PROD
	help
		Select the OTDOA library build to link
	config OTDOA_LIB_TYPE_PROD
		bool "Standard production release"
	config OTDOA_LIB_TYPE_DBG
		bool "Debug release with verbose logging"
	config OTDOA_LIB_TYPE_DEV
		bool "Developer release with capture functions"
	endchoice

config OTDOA_LITTLE_FS
	bool "Use an OTDOA-provided LittleFS filesystem"
	default y

config OTDOA_EXTERNAL_STORAGE
	bool "Use external flash filesystem for OTDOA files"
	default y

config OTDOA_CFG_DL_INTERVAL
	int "Interval between uBSA downloads to trigger a config download"
	default 5

config OTDOA_PRS_SAMPLES_BUFFER_COUNT
	int "Number of buffer slabs for PRS samples"
	default 1

config OTDOA_HTTP_BLACKLIST_TIMEOUT
	int "Number of uBSA requests to make before removing an SC ECGI from the DL blacklist"
	default 20

config OTDOA_HTTP_QUEUE_STACK_SIZE
	int "HTTP work queue stack size in bytes"
	default 2048

config OTDOA_HTTP_QUEUE_PRIORITY
	int "HTTP work queue priority"
	default 5

config OTDOA_RS_THREAD_STACK_SIZE
	int "RS work queue stack size in bytes"
	default 4096

config OTDOA_RS_THREAD_PRIORITY
	int "RS work queue priority"
	default 5

config OTDOA_API_TLS_CERT_INSTALL
	bool "Install a TLS certificate through the OTDOA library using otdoa_api_install_tls_cert()"
	default y

config OTDOA_TLS_SEC_TAG
	int "Modem security tag slot to install PhyWi TLS certificate to"
	default 42

config OTDOA_HTTPS_PORT
	int "Port to use for OTDOA HTTPS operations"
	default 443

config OTDOA_HTTP_PORT
	int "Port to use for OTDOA HTTP operations"
	default 80

config OTDOA_ENABLE_RESULTS_UPLOAD
	bool "Upload of OTDOA results to a server"
	default n

config OTDOA_RESULTS_UPLOAD_PW
	string "Password to use for Phywi API authentication when uploading OTDOA results"
	default ""
	depends on OTDOA_ENABLE_RESULTS_UPLOAD

config OTDOA_UPLOAD_SERVER_URL
	string "URL to upload OTDOA results to"
	default "api.prod.hellaphy.cloud"
	depends on OTDOA_ENABLE_RESULTS_UPLOAD

choice "OTDOA_AL_LOG_LEVEL_CHOICE"
	prompt "Max compiled-in log level for $(module-str)"
	default OTDOA_AL_LOG_LEVEL_DEFAULT
	depends on LOG

config OTDOA_AL_LOG_LEVEL_OFF
	bool "Off"

config OTDOA_AL_LOG_LEVEL_ERR
	bool "Error"

config OTDOA_AL_LOG_LEVEL_WRN
	bool "Warning"

config OTDOA_AL_LOG_LEVEL_INF
	bool "Info"

config OTDOA_AL_LOG_LEVEL_DBG
	bool "Debug"

config OTDOA_AL_LOG_LEVEL_DEFAULT
	bool "Default"

endchoice

config OTDOA_AL_LOG_LEVEL
	int
	depends on LOG
	default 0 if OTDOA_AL_LOG_LEVEL_OFF
	default 1 if OTDOA_AL_LOG_LEVEL_ERR
	default 2 if OTDOA_AL_LOG_LEVEL_WRN
	default 3 if OTDOA_AL_LOG_LEVEL_INF
	default 4 if OTDOA_AL_LOG_LEVEL_DBG
	default 2 if OTDOA_AL_LOG_LEVEL_DEFAULT

endif # OTDOA_AL_LIB
```
